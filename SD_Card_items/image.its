## SD_Card_items/image.its
```
/dts-v1/;

/ {
    description = "U-Boot fitImage for Custom Zynq Kernel/DTB";
    #address-cells = <1>;

    images {
        kernel {
            description = "Linux Kernel";
            data = "/mnt/d/BS_ES/EL_FPGA/coco_tb/cocotb_demo/SD_Card_items/zImage"; // Ensure this path is correct
            type = "kernel";
            arch = "arm";
            os = "linux";
            compression = "gzip";
            load-address = <0x00080000>; // Standard Zynq kernel load address
            entry-point = <0x00080000>; // Standard Zynq kernel entry point
            hash{
                algo = "sha1";
            };
        };

        fdt {
            description = "Flattened Device Tree blob";
            data = "/mnt/d/BS_ES/EL_FPGA/coco_tb/cocotb_demo/SD_Card_items/zynq-zed-week6.dtb"; // Ensure this path is correct
            type = "flat_dt";
            arch = "arm";
            compression = "none";
            hash {
                algo = "sha1";
            };
        };
    };

    configurations {
        default = "conf";
        conf {
            description = "Boot Linux kernel with custom FDT blob";
            kernel = "kernel";
            fdt = "fdt";
            hash {
                algo = "sha1";
            };
        };
    };
};
```

## image.its
```
/dts-v1/;

/ {
    description = "FIT image for PYNQ-Z1 kernel";
    #address-cells = <1>;

    images {
        kernel {
            description = "Linux kernel";
            data = /incbin/("zImage");
            type = "kernel";
            arch = "arm";
            os = "linux";
            compression = "none";
            load = <0xc0208000>;        /* kernel load address as before */
            entry = <0xc0208000>;
        };
        fdt {
            description = "Flattened device tree";
            data = /incbin/("zynq-zed-week6.dtb");
            type = "flat_dt";
            compression = "none";
            load = <0x02000000>;         /* <-- safe RAM address for DTB */
        };
    };

    configurations {
        default = "conf";
        conf {
            kernel = "kernel";
            fdt = "fdt";
        };
    };
};
```
